#include <Arduino.h>
#ifdef ESP32
 #include <WiFi.h>
  #include <HTTPClient.h>
  #include "time.h"
  #include "DHT.h"
  #include <NTPClient.h>
  #include <WiFiUdp.h>
  #include <SPI.h>
  #include <Adafruit_GFX.h>
  #include <Adafruit_SSD1306.h>
#else
  #include <ESP8266WiFi.h>
  #include <ESP8266HTTPClient.h>
  #include <WiFiClient.h>
#endif
#include <Wire.h>
WiFiUDP ntpUDP;
Adafruit_SSD1306 display(128, 32, &Wire, -1);
// Replace with your network credentials
const char* ssid     = "EULE-Gast";
const char* password = "@EULE_Zukunft!";
NTPClient timeClient(ntpUDP, "0.de.pool.ntp.org", 7200, 2500);
// REPLACE with your Domain name and URL path or IP address with path
const char* serverName = "http://192.168.1.23/API/post-esp-data.php";
const char* ntpServer = "0.de.pool.ntp.org";
const long  gmtOffset_sec = 3600;
const int   daylightOffset_sec = 3600;
long int UNIX = 0; 
float CURRENT = 0;
float VOLTAGE = 0;
float POWER = 0;
float INTENSITY =0;
String datum;
String formattedDate;
String dayStamp;
String timeStamp;
int S_1 = 0;
int S_2 = 0;
int S_3 = 0;
int S_4 = 0;
char StateArray[4];
float h;
float t;
// 'logo', 128x32px
const unsigned char BOTTLOGO1 [] PROGMEM = {
	0x00, 0x00, 0x00, 0x00, 0x00, 0x00, 0x00, 0x00, 0x00, 0x00, 0x00, 0x00, 0x00, 0x00, 0x00, 0x00, 
	0x00, 0x00, 0x00, 0x00, 0x00, 0x00, 0x00, 0x00, 0x00, 0x00, 0x00, 0x00, 0x00, 0x00, 0x00, 0x00, 
	0x00, 0x00, 0x00, 0x00, 0x00, 0x00, 0x03, 0x81, 0x80, 0x00, 0x00, 0x00, 0x00, 0x00, 0x00, 0x00, 
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	0x00, 0x00, 0x00, 0x00, 0x00, 0x00, 0x00, 0x00, 0x00, 0x00, 0x00, 0x00, 0x00, 0x00, 0x00, 0x00
};
// Keep this API Key value to be compatible with the PHP code provided in the project page. 
// If you change the apiKeyValue value, the PHP file /post-esp-data.php also needs to have the same key 
String apiKeyValue = "tPmAT5Ab3j7F9";
#define DHTTYPE DHT11
#define DHTPIN 14
int httpResponseCode; 
void printLocalTime()
{
  struct tm timeinfo;
  if(!getLocalTime(&timeinfo)){
    Serial.println("Failed to obtain time");
    return;
    }
time_t now;
time(&now);
UNIX = now;
}
void ADC_READ(){
  int Value;
  Value = analogRead(35);
  Value = constrain(Value,0,2900);
  Value = map(Value,0,2900,0,1000);
  CURRENT = Value;
}
void Voltage(){
int Value;
Value = analogRead(34);
Value = constrain(Value,0.0,3550.0);
Value = map(Value,0.0,3550.0,0.0,12.0);
VOLTAGE = Value;
}
void Leistung(){
float Value;
float C_A;
C_A = CURRENT/1000;
Value = VOLTAGE*C_A;
POWER = Value;
}
void LDR(){
float Value;
Value = analogRead(32);
Value = map(Value,0,4096,0,101);
INTENSITY = Value;
}
void DATUM(){
timeClient.update();
datum = timeClient.getFormattedTime();
}
void Status(){
if(S_1 == 1){
StateArray[0] = '1';
}
if(S_1 == 0){
StateArray[0] = '0';
}
if(S_2 == 1){
StateArray[1] = '1';
}
if(S_2 == 0){
StateArray[1] = '0';
}
if(S_3 == 1){
StateArray[2] = '1';
}
if(S_3 == 0){
StateArray[2] = '0';
}
if(S_4 == 1){
StateArray[3] = '1';
}
if(S_4 == 0){
StateArray[3] = '0';
}
StateArray[4] = 0;
}
void R1(bool state){
S_1 = state;
if(state == 1){
digitalWrite(17,LOW);
}
else{
digitalWrite(17,HIGH);
}
}
void R2(bool state){
S_2 = state;
if(state == 1){
digitalWrite(5,LOW);
}
else{
digitalWrite(5,HIGH);
}
}
void R3(bool state){
S_3 = state;
if(state == 1){
digitalWrite(18,LOW);
}
else{
digitalWrite(18,HIGH);
}
}
void R4(bool state){
S_4 = state;
if(state == 1){
digitalWrite(19,LOW);
}
else{
digitalWrite(19,HIGH);
}
}
void COLORS_R(){
if(httpResponseCode == 100){
R1(1);
R2(0);
R3(0);
}
else if(httpResponseCode == 404){
R1(0);
R2(1);
R3(0);
}
else if(httpResponseCode == 101){
R1(0);
R2(0);
R3(1);
}
else if(httpResponseCode == 102){
R1(1);
R2(1);
R3(0);;
}
else if(httpResponseCode == 200){
R1(1);
R2(0);
R3(1);
}
else if(httpResponseCode == 203){
R1(1);
R2(0);
R3(1);
}
else if(httpResponseCode == 206){
R1(1);
R2(1);
R3(1);
}
else if(httpResponseCode == 501){
R4(1);
}
else if(httpResponseCode == 502){
R4(0);
}
else if(httpResponseCode == 403){
R1(0);
R2(0);
R3(0);
R4(0);
}
}
void OLED(){
  display.clearDisplay();
  display.display();
  display.setTextSize(1);
  display.setTextColor(WHITE);
  display.setCursor(0, 0);
  display.print("IP:");
  display.display(); 
  display.setCursor(20, 0);
  display.print("192.168.1.23");
  display.display(); 
  display.setCursor(0, 10);
  display.println("Temp:");
  display.setCursor(30, 10);
  display.print(t);
  display.display(); 
  display.setCursor(65, 10);
  display.println("Hum:");
  display.setCursor(95, 10);
  display.print(h);
  display.display();
  display.setCursor(0, 20);
  display.println("V:");
  display.setCursor(15, 20);
  display.print(VOLTAGE);
  display.display();
  display.setCursor(65, 20);
  display.println("mA:");
  display.setCursor(85, 20);
  display.print(CURRENT);
  display.display();
}
DHT dht(DHTPIN, DHTTYPE);
void setup() {
  display.begin(SSD1306_SWITCHCAPVCC, 0x3C);
  display.clearDisplay();
  display.display();
  display.drawBitmap(0, 0,  BOTTLOGO1, 128, 32, WHITE);
  display.display();
  delay(3000);
  Serial.begin(115200);
  analogReadResolution(12);
  analogSetAttenuation(ADC_11db);
  WiFi.begin(ssid, password);
  Serial.println("Connecting");
  while(WiFi.status() != WL_CONNECTED) { 
    delay(500);
    Serial.print(".");
  }
  Serial.println("");
  Serial.print("Connected to WiFi network with IP Address: ");
  Serial.println(WiFi.localIP());
  configTime(gmtOffset_sec, daylightOffset_sec, ntpServer);
  printLocalTime();
  // (you can also pass in a Wire library object like &Wire2)
 dht.begin();
 timeClient.begin();
 pinMode(17,OUTPUT);
 pinMode(5,OUTPUT);
 pinMode(18,OUTPUT);
 pinMode(19,OUTPUT);
 R1(0);
 R2(0);
 R3(0);
 R4(0);
}

void loop() {
  printLocalTime();
  ADC_READ();
  Voltage();
  Leistung();
  LDR();
  DATUM();
  Status();
  COLORS_R();
  OLED();
  h = dht.readHumidity();
  // Read temperature as Celsius (the default)
  t = dht.readTemperature();
  //Check WiFi connection status
  if(WiFi.status()== WL_CONNECTED){
    HTTPClient http;
    
    // Your Domain name with URL path or IP address with path
    http.begin(serverName);
    
    // Specify content-type header
    http.addHeader("Content-Type", "application/x-www-form-urlencoded");
    
    String httpRequestData = "api_key=" + apiKeyValue + "&strom=" + String(CURRENT)
                           + "&spannung=" + String(VOLTAGE) + "&watt=" + String(POWER)
                           + "&lichtstaerke=" + String(INTENSITY) + "&temperatur=" + String(t) + "&luftfeuchtigkeit=" + String(h) 
                           + "&status=" + String(StateArray) + "&time=" + String(UNIX) + "&datum=" + String(datum) +"";           
    Serial.print("httpRequestData: ");
    Serial.println(httpRequestData);
    

    // Send HTTP POST request
     httpResponseCode = http.POST(httpRequestData);
     

        
    if (httpResponseCode>0) {
      Serial.print("HTTP Response code: ");
      Serial.println(httpResponseCode);
    }
    else {
      Serial.print("Error code: ");
      Serial.println(httpResponseCode);
    }
    // Free resources
    http.end();
  }
  else {
    Serial.println("WiFi Disconnected");
  }
  //Send an HTTP POST request every 30 seconds
  delay(5000);  
}
